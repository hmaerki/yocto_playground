## yocto3_1/build/conf/bblayers.conf
```bitbake
# POKY_BBLAYERS_CONF_VERSION is increased each time build/conf/bblayers.conf
# changes incompatibly
POKY_BBLAYERS_CONF_VERSION = "2"

BBPATH = "${TOPDIR}"
BBFILES ?= ""

BBLAYERS ?= " \
  /home/poky_builder/poky/meta \
  /home/poky_builder/poky/meta-poky \
  /home/poky_builder/poky/meta-yocto-bsp \
  "
```

## yocto5_0-devcontainer/build/conf/bblayers.conf
```bitbake
# POKY_BBLAYERS_CONF_VERSION is increased each time build/conf/bblayers.conf
# changes incompatibly
POKY_BBLAYERS_CONF_VERSION = "2"

BBPATH = "${TOPDIR}"
BBFILES ?= ""

BBLAYERS ?= " \
  /workspaces/yocto_playground/yocto5_0-devcontainer/sources/poky/meta \
  /workspaces/yocto_playground/yocto5_0-devcontainer/sources/poky/meta-poky \
  /workspaces/yocto_playground/yocto5_0-devcontainer/sources/poky/meta-yocto-bsp \
  /workspaces/yocto_playground/yocto5_0-devcontainer/sources/meta-sandbox \
  "
```

## yocto5_0-devcontainer/sources/meta-sandbox/conf/layer.conf
```bitbake
BBPATH .= ":${LAYERDIR}"

# BBFILES += "${LAYERDIR}/recipes-*/*/*.bb \
#             ${LAYERDIR}/recipes-*/*/*.bbappend"
BBFILES += "${LAYERDIR}/recipe-*/*.bb \
            ${LAYERDIR}/recipe-*/*.bbappend"

BBFILE_COLLECTIONS += "meta-sandbox"
BBFILE_PATTERN_meta-sandbox = "^${LAYERDIR}/"
BBFILE_PRIORITY_meta-sandbox = "6"

LAYERVERSION_meta-sandbox = "1"
LAYERSERIES_COMPAT_meta-sandbox = "scarthgap"
```
